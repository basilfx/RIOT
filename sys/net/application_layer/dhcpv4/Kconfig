## sys/net/application_layer/dhcpv4/Kconfig
```kconfig
# Copyright (c) 2026 Bas Stottelaar
#
# This file is subject to the terms and conditions of the GNU Lesser
# General Public License v2.1. See the file LICENSE in the top level
# directory for more details.
#

menu "DHCPv4"
    depends on USEMODULE_DHCPV4

menu "DHCPv4 client"
    depends on USEMODULE_DHCPV4_CLIENT

config DHCPV4_CLIENT_ROUTE_MAX
    int "Maximum number of classless static routes applied from a lease"
    default 2

config DHCPV4_CLIENT_INIT_DELAY_MS
    int "Maximum random delay before the first DISCOVER (in ms)"
    default 2000

config DHCPV4_CLIENT_INITIAL_RT_MS
    int "Initial retransmission timeout (in ms)"
    default 4000

config DHCPV4_CLIENT_MAX_RT_MS
    int "Upper bound the retransmission timeout is doubled to (in ms)"
    default 64000

config DHCPV4_CLIENT_REQUEST_MAX_RC
    int "Maximum number of REQUEST retransmissions before giving up on the offer"
    default 4

config DHCPV4_CLIENT_DECLINE_DELAY_MS
    int "Delay before restarting after a DECLINE (in ms)"
    default 10000

endmenu # DHCPv4 client
endmenu # DHCPv4
```

## sys/net/gnrc/network_layer/ipv4/Kconfig
```kconfig
# Copyright (c) 2026 Bas Stottelaar
#
# This file is subject to the terms and conditions of the GNU Lesser
# General Public License v2.1. See the file LICENSE in the top level
# directory for more details.
#
menu "IPv4"

menu "GNRC IPv4 module"
    depends on USEMODULE_GNRC_IPV4

config GNRC_IPV4_MSG_QUEUE_SIZE_EXP
    int "Exponent for the message queue size used for the IPv4 thread (as 2^n)"
    default 3
    help
        As the queue size ALWAYS needs to be power of two, this option
        represents the exponent of 2^n, which will be used as the size of
        the queue.

config GNRC_IPV4_FT_SIZE
    int "Maximum number of entries in the forwarding table"
    default 4

endmenu # GNRC IPv4 module

menu "GNRC IPv4 ARP"
    depends on USEMODULE_GNRC_IPV4_ARP

config GNRC_IPV4_ARP_CACHE_SIZE
    int "Maximum number of entries in the ARP cache"
    default 4

config GNRC_IPV4_ARP_REQUEST_TIMEOUT_MS
    int "Time between two retransmissions of an ARP request (in ms)"
    default 1000

config GNRC_IPV4_ARP_MAX_RETRIES
    int "Maximum number of ARP request retransmissions before giving up"
    default 3

config GNRC_IPV4_ARP_CACHE_TIMEOUT_MS
    int "Lifetime of a resolved cache entry before it is re-resolved (in ms)"
    default 1200000

endmenu # GNRC IPv4 ARP

menu "GNRC IPv4 fragmentation and reassembly"
    depends on USEMODULE_GNRC_IPV4_FRAG

config GNRC_IPV4_FRAG_RBUF_SIZE
    int "Maximum number of datagrams reassembled at the same time"
    default 1

config GNRC_IPV4_FRAG_LIMITS_POOL_SIZE
    int "Maximum number of not-yet-coalesced fragment intervals (shared across all in-progress reassemblies)"
    default 4

config GNRC_IPV4_FRAG_RBUF_TIMEOUT_MS
    int "Time a partial datagram is kept before it is discarded (in ms)"
    default 60000

endmenu # GNRC IPv4 fragmentation and reassembly

endmenu # IPv4
```
