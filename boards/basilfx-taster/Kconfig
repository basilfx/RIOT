## boards/basilfx-taster/Kconfig
```kconfig
# Copyright (c) 2020 HAW Hamburg
#
# This file is subject to the terms and conditions of the GNU Lesser
# General Public License v2.1. See the file LICENSE in the top level
# directory for more details.

config BOARD
    default "basilfx-taster" if BOARD_BASILFX_TASTER

config BOARD_BASILFX_TASTER
    bool
    default y
    select CPU_MODEL_EFM32PG12B500F1024GM48
    select HAS_PERIPH_ADC
    select HAS_PERIPH_RTC
    select HAS_PERIPH_RTT
    select HAS_PERIPH_SPI
    select HAS_PERIPH_TIMER
    select HAS_PERIPH_UART
    select HAS_PERIPH_UART_MODECFG
    select HAS_EFM32_CORETEMP
    select HAS_RIOTBOOT
```

## drivers/tpuart/Kconfig
```kconfig
# Copyright (c) 2020 HAW Hamburg
#
# This file is subject to the terms and conditions of the GNU Lesser
# General Public License v2.1. See the file LICENSE in the top level
# directory for more details.
#

config MODULE_TPUART
    bool "TPUART KNX transceiver"
    depends on HAS_PERIPH_GPIO
    depends on HAS_PERIPH_GPIO_IRQ
    depends on HAS_PERIPH_UART
    depends on HAS_PERIPH_UART_MODECFG
    select MODULE_CHECKSUM
    select MODULE_IOLIST
    select MODULE_ISRPIPE
    select MODULE_ISRPIPE_READ_TIMEOUT
    select MODULE_NETDEV_KNX
    select MODULE_XTIMER
    help
        TPUART KNX transceiver.
```
